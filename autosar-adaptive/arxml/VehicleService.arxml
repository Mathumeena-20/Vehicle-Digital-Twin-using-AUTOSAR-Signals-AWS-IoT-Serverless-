AUTOSAR XML (schema 4.0)
package /Services
  service interface VehicleTelemetryService
    events:
      data VehicleStateEvent
