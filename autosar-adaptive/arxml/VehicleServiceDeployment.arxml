AUTOSAR XML (schema 4.0)
package /Deployment
  someip service interface deployment VehicleServiceSOMEIP: service-interface=VehicleTelemetryService
