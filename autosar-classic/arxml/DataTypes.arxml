AUTOSAR XML (schema 4.0)
standard types defined: uint16
package /DataTypes
  integer type int8
