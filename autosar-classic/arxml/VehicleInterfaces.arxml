AUTOSAR XML (schema 4.0)
package /Interfaces
  sender receiver interface VehicleSignalInterface
    data VehicleSpeed: type=uint16
    data EngineRPM: type=uint16
    data CoolantTemp: type=int8
