AUTOSAR XML (schema 4.0)
package /SWC
  application software component type VehicleStateSWC
    provide port PpVehicleSignals: provided-interface=VehicleSignalInterface
